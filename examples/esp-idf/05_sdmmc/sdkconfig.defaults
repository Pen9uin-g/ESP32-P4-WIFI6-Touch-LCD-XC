## examples/esp-idf/05_sdmmc/sdkconfig.defaults
```kconfig
CONFIG_IDF_TARGET="esp32p4"
CONFIG_ESP32P4_SELECTS_REV_LESS_V3=n
CONFIG_ESP32P4_REV_MIN_300=y
CONFIG_SPIRAM_SPEED_250M=y
CONFIG_SPIRAM_SPEED=250
CONFIG_FATFS_VFS_FSTAT_BLKSIZE=4096
```

## examples/esp-idf/07_Displaycolorbar/sdkconfig.defaults
```kconfig
CONFIG_IDF_TARGET="esp32p4"
CONFIG_ESP32P4_SELECTS_REV_LESS_V3=n
CONFIG_ESP32P4_REV_MIN_300=y
CONFIG_SPIRAM_SPEED_250M=y
CONFIG_SPIRAM_SPEED=250
CONFIG_ESP_TASK_WDT_EN=n
CONFIG_FREERTOS_HZ=1000
CONFIG_FREERTOS_TIMER_TASK_STACK_DEPTH=4096
```

## firmware/brookesia/sdkconfig.defaults.3_4c
```kconfig
# ESP32-P4-WIFI6-Touch-LCD-3.4C (800x800) panel selection.
CONFIG_BSP_LCD_TYPE_800_800_3_4_INCH=y
# CONFIG_BSP_LCD_TYPE_720_720_4_INCH is not set
```

## firmware/brookesia/sdkconfig.defaults.4c
```kconfig
# ESP32-P4-WIFI6-Touch-LCD-4C (720x720) panel selection.
# CONFIG_BSP_LCD_TYPE_800_800_3_4_INCH is not set
CONFIG_BSP_LCD_TYPE_720_720_4_INCH=y
```
